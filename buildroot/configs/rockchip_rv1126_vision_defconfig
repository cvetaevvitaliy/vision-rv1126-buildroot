## buildroot/configs/rockchip_rv1126_vision_defconfig
```kconfig
#include "base.config"
#include "base_extra.config"
#include "debug.config"
# #include "audio.config"
#include "wifi.config"
#include "network.config"
# #include "bt.config"
#include "video_mpp.config"
#include "rv1126_rv1109_arm.config"
#include "camera.config"
#include "updateEngine.config"
#include "ipc_quick_display.config"
#include "video_gst.config"
#include "video_gst_rtsp.config"
BR2_TOOLCHAIN_EXTERNAL_DOWNLOAD=y
BR2_TOOLCHAIN_EXTERNAL_URL="https://armkeil.blob.core.windows.net/developer/Files/downloads/gnu-a/8.3-2019.03/binrel/gcc-arm-8.3-2019.03-x86_64-arm-linux-gnueabihf.tar.xz"
BR2_TARGET_GENERIC_ROOT_PASSWD="123qwe"
BR2_TARGET_GENERIC_GETTY_BAUDRATE_115200=y
BR2_TARGET_TZ_INFO=y
BR2_TARGET_LOCALTIME="Europe/Kiev"
BR2_ROOTFS_OVERLAY="board/rockchip/rv1126_rv1109/fs-overlay-vision"
BR2_PACKAGE_BUSYBOX_CONFIG="board/rockchip/rv1126_rv1109/fs-overlay-vision/busybox.config"
BR2_PACKAGE_CAMERA_ENGINE_RKAIQ_IQFILE="os04a10_CMK-OT1607-FV1_M12-40IRC-4MP-F16.xml ov2718_YT-RV1109-3-V1_M43-4IR-2MP-F2.xml gc2053_YT-RV1109-2-V1_40IR-2MP-F20.xml gc2093_YT-RV1109-2-V1_40IR-2MP-F20.xml gc4663_TRC-2232A6_28IRC-4M-F22-v1.0x23.xml"
BR2_PACKAGE_RKMEDIA_MPP=y
BR2_PACKAGE_RKMEDIA_RKNN=y
BR2_PACKAGE_RKMEDIA_ROCKX=y
BR2_PACKAGE_RKMEDIA_MOVE_DETECTION=y
BR2_PACKAGE_RKMEDIA_OCCLUSION_DETECTION=y
BR2_PACKAGE_RKMEDIA_LIVE555=y
BR2_PACKAGE_RKMEDIA_RTSP_SERVER=y
BR2_PACKAGE_RKMEDIA_RTSP_SERVER_H264=y
BR2_PACKAGE_RKMEDIA_RTSP_SERVER_H265=y
BR2_PACKAGE_RKMEDIA_SOCKET=y
BR2_PACKAGE_ROCKIT=y
BR2_PACKAGE_NPU_POWERCTRL=y
BR2_PACKAGE_NPU_POWERCTRL_COMBINE=y
# BR2_PACKAGE_MINIGUI_SOFTWARE_SCALE is not set
# BR2_PACKAGE_ROCKX_FACE_DETECTION is not set
# BR2_PACKAGE_ROCKX_FACE_LANDMARK is not set
# BR2_PACKAGE_ROCKX_POSE_FINGER is not set
BR2_PACKAGE_COMMON_ALGORITHM_ANR=y
BR2_PACKAGE_LIBIPCPROTOCOL=y
BR2_PACKAGE_DBSERVER=y
BR2_PACKAGE_STORAGE_MANAGER=y
BR2_PACKAGE_CALLFUNIPC=y
BR2_PACKAGE_ISP2_IPC=y
BR2_PACKAGE_ISP2_IPC_DBUS=y
BR2_PACKAGE_ISP2_IPC_DBSERVER=y
BR2_PACKAGE_ISP2_IPC_MINILOGGER=y
BR2_PACKAGE_PCBA_ADB_TEST=y
BR2_PACKAGE_RKAIQ_TOOL_SERVER=y
BR2_PACKAGE_FFMPEG_NONFREE=y
BR2_PACKAGE_FFMPEG_ENCODERS="mp2 adpcm_g726 pcm_alaw pcm_mulaw rawvideo mjpeg mpeg2video aac h264"
BR2_PACKAGE_FFMPEG_DECODERS="pcm_alaw pcm_mulaw rawvideo mjpeg mpeg2video aac h264"
BR2_PACKAGE_FFMPEG_MUXERS="pcm_alaw pcm_mulaw g722 g726 adts rawvideo mjpeg mp4 mov rtp flv f4v mpegts matroska avi rtsp mpeg1system h264"
BR2_PACKAGE_FFMPEG_DEMUXERS="pcm_alaw pcm_mulaw g722 g726 rawvideo mpegts mov flv matroska avi rtsp h264"
BR2_PACKAGE_FFMPEG_PARSERS="aac h264"
BR2_PACKAGE_FFMPEG_BSFS="aac_adtstoasc h264_metadata h264_mp4toannexb h264_redundant_pps hevc_metadata hevc_mp4toannexb dump_extradata remove_extradata"
BR2_PACKAGE_FFMPEG_PROTOCOLS="file rtp srtp rtmp rtmps http https"
BR2_PACKAGE_FFMPEG_FILTERS="scale"
BR2_PACKAGE_GDB=y
BR2_PACKAGE_GDB_SERVER=y
BR2_PACKAGE_GDB_DEBUGGER=y
BR2_PACKAGE_STRESS=y
BR2_PACKAGE_VALGRIND=y
BR2_PACKAGE_VALGRIND_LACKEY=y
BR2_PACKAGE_EXFAT=y
BR2_PACKAGE_EXFAT_UTILS=y
BR2_PACKAGE_LINUX_FIRMWARE=y
BR2_PACKAGE_LINUX_FIRMWARE_RTL_81XX=y
BR2_PACKAGE_LINUX_FIRMWARE_RTL_87XX=y
BR2_PACKAGE_LINUX_FIRMWARE_RTL_88XX=y
BR2_PACKAGE_LM_SENSORS=y
BR2_PACKAGE_MINICOM=y
BR2_PACKAGE_FDK_AAC=y
BR2_PACKAGE_VO_AACENC=y
BR2_PACKAGE_LIBSODIUM=y
BR2_PACKAGE_LIBOPENSSL_1_0=y
BR2_PACKAGE_LIBOPENSSL_BIN=y
BR2_PACKAGE_SQLITE_STAT3=y
BR2_PACKAGE_SQLITE_ENABLE_FTS3=y
BR2_PACKAGE_SQLITE_ENABLE_JSON1=y
BR2_PACKAGE_SQLITE_ENABLE_UNLOCK_NOTIFY=y
BR2_PACKAGE_SQLITE_SECURE_DELETE=y
BR2_PACKAGE_CAIRO=y
BR2_PACKAGE_CAIRO_PNG=y
BR2_PACKAGE_EXIV2=y
BR2_PACKAGE_JASPER=y
BR2_PACKAGE_OPENCV4=y
BR2_PACKAGE_OPENCV4_LIB_SHAPE=y
BR2_PACKAGE_OPENCV4_LIB_STITCHING=y
BR2_PACKAGE_OPENCV4_LIB_SUPERRES=y
BR2_PACKAGE_OPENCV4_LIB_TS=y
BR2_PACKAGE_OPENCV4_LIB_VIDEOSTAB=y
BR2_PACKAGE_OPENCV4_WITH_FFMPEG=y
BR2_PACKAGE_OPENCV4_WITH_GSTREAMER1=y
BR2_PACKAGE_OPENCV4_JPEG2000_WITH_OPENJPEG=y
BR2_PACKAGE_OPENCV4_WITH_JPEG=y
BR2_PACKAGE_OPENCV4_WITH_PNG=y
BR2_PACKAGE_OPENCV4_WITH_TBB=y
BR2_PACKAGE_OPENCV4_WITH_TIFF=y
BR2_PACKAGE_OPENCV4_WITH_V4L=y
BR2_PACKAGE_OPENCV4_INSTALL_DATA=y
BR2_PACKAGE_OPENCV4_CONTRIB=y
BR2_PACKAGE_OPENCV4_CONTRIB_LIB_ALPHAMAT=y
BR2_PACKAGE_OPENCV4_CONTRIB_LIB_ARUCO=y
BR2_PACKAGE_OPENCV4_CONTRIB_LIB_BARCODE=y
BR2_PACKAGE_OPENCV4_CONTRIB_LIB_BGSEGM=y
BR2_PACKAGE_OPENCV4_CONTRIB_LIB_BIOINSPIRED=y
BR2_PACKAGE_OPENCV4_CONTRIB_LIB_CCALIB=y
BR2_PACKAGE_OPENCV4_CONTRIB_LIB_CNN_3DOBJ=y
BR2_PACKAGE_OPENCV4_CONTRIB_LIB_CVV=y
BR2_PACKAGE_OPENCV4_CONTRIB_LIB_DATASETS=y
BR2_PACKAGE_OPENCV4_CONTRIB_LIB_DNN_OBJDETECT=y
BR2_PACKAGE_OPENCV4_CONTRIB_LIB_DNN_SUPERRES=y
BR2_PACKAGE_OPENCV4_CONTRIB_LIB_DNNS_EASILY_FOOLED=y
BR2_PACKAGE_OPENCV4_CONTRIB_LIB_DPM=y
BR2_PACKAGE_OPENCV4_CONTRIB_LIB_FACE=y
BR2_PACKAGE_OPENCV4_CONTRIB_LIB_FREETYPE=y
BR2_PACKAGE_OPENCV4_CONTRIB_LIB_FUZZY=y
BR2_PACKAGE_OPENCV4_CONTRIB_LIB_HDF=y
BR2_PACKAGE_OPENCV4_CONTRIB_LIB_HFS=y
BR2_PACKAGE_OPENCV4_CONTRIB_LIB_IMG_HASH=y
BR2_PACKAGE_OPENCV4_CONTRIB_LIB_INTENSITY_TRANSFORM=y
BR2_PACKAGE_OPENCV4_CONTRIB_LIB_JULIA=y
BR2_PACKAGE_OPENCV4_CONTRIB_LIB_LINE_DESCRIPTOR=y
BR2_PACKAGE_OPENCV4_CONTRIB_LIB_MATLAB=y
BR2_PACKAGE_OPENCV4_CONTRIB_LIB_MCC=y
BR2_PACKAGE_OPENCV4_CONTRIB_LIB_OPTFLOW=y
BR2_PACKAGE_OPENCV4_CONTRIB_LIB_OVIS=y
BR2_PACKAGE_OPENCV4_CONTRIB_LIB_PHASE_UNWRAPPING=y
BR2_PACKAGE_OPENCV4_CONTRIB_LIB_PLOT=y
BR2_PACKAGE_OPENCV4_CONTRIB_LIB_QUALITY=y
BR2_PACKAGE_OPENCV4_CONTRIB_LIB_RAPID=y
BR2_PACKAGE_OPENCV4_CONTRIB_LIB_REG=y
BR2_PACKAGE_OPENCV4_CONTRIB_LIB_RGBD=y
BR2_PACKAGE_OPENCV4_CONTRIB_LIB_SALIENCY=y
BR2_PACKAGE_OPENCV4_CONTRIB_LIB_SFM=y
BR2_PACKAGE_OPENCV4_CONTRIB_LIB_SHAPE=y
BR2_PACKAGE_OPENCV4_CONTRIB_LIB_STEREO=y
BR2_PACKAGE_OPENCV4_CONTRIB_LIB_STRUCTURED_LIGHT=y
BR2_PACKAGE_OPENCV4_CONTRIB_LIB_SUPERRES=y
BR2_PACKAGE_OPENCV4_CONTRIB_LIB_SURFACE_MATCHING=y
BR2_PACKAGE_OPENCV4_CONTRIB_LIB_TEXT=y
BR2_PACKAGE_OPENCV4_CONTRIB_LIB_TRACKING=y
BR2_PACKAGE_OPENCV4_CONTRIB_LIB_VIDEOSTAB=y
BR2_PACKAGE_OPENCV4_CONTRIB_LIB_VIZ=y
BR2_PACKAGE_OPENCV4_CONTRIB_LIB_WECHAT_QRCODE=y
BR2_PACKAGE_OPENCV4_CONTRIB_LIB_XFEATURES2D=y
BR2_PACKAGE_OPENCV4_CONTRIB_LIB_XIMGPROC=y
BR2_PACKAGE_OPENCV4_CONTRIB_LIB_XOBJDETECT=y
BR2_PACKAGE_OPENCV4_CONTRIB_LIB_XPHOTO=y
BR2_PACKAGE_LIBAIO=y
BR2_PACKAGE_LIBINPUT=y
BR2_PACKAGE_LIBV4L_QV4L2=y
BR2_PACKAGE_LIBXKBCOMMON=y
BR2_PACKAGE_CJSON=y
BR2_PACKAGE_JSON_FOR_MODERN_CPP=y
BR2_PACKAGE_JSON_GLIB=y
BR2_PACKAGE_JSONCPP=y
BR2_PACKAGE_LIBJSON=y
BR2_PACKAGE_LIBXML2=y
BR2_PACKAGE_SPDLOG=y
BR2_PACKAGE_LIBAACS=y
BR2_PACKAGE_LIBCGICC=y
BR2_PACKAGE_INIPARSER=y
BR2_PACKAGE_LIBCAP=y
BR2_PACKAGE_LIBCAP_TOOLS=y
BR2_PACKAGE_LIBGLOB=y
BR2_PACKAGE_NCURSES_WCHAR=y
BR2_PACKAGE_NCURSES_TARGET_PROGS=y
BR2_PACKAGE_PCRE2=y
BR2_PACKAGE_PCRE2_16=y
BR2_PACKAGE_AVAHI=y
BR2_PACKAGE_AVAHI_DAEMON=y
BR2_PACKAGE_AVAHI_LIBDNSSD_COMPATIBILITY=y
BR2_PACKAGE_CONNMAN=y
BR2_PACKAGE_CONNMAN_WIFI=y
BR2_PACKAGE_CONNMAN_LOOPBACK=y
BR2_PACKAGE_CONNMAN_CLIENT=y
BR2_PACKAGE_DHCP=y
BR2_PACKAGE_DHCP_SERVER=y
BR2_PACKAGE_DHCP_SERVER_DELAYED_ACK=y
BR2_PACKAGE_FCGIWRAP=y
BR2_PACKAGE_NETWORK_MANAGER=y
BR2_PACKAGE_NETWORK_MANAGER_TUI=y
BR2_PACKAGE_NTP_NTP_KEYGEN=y
# BR2_PACKAGE_NTP_NTPD is not set
BR2_PACKAGE_NTP_NTPDATE=y
BR2_PACKAGE_NTP_NTPTIME=y
BR2_PACKAGE_RSYNC=y
BR2_PACKAGE_SOCAT=y
BR2_PACKAGE_TCPDUMP=y
BR2_PACKAGE_CPULOAD=y
BR2_PACKAGE_HTOP=y
BR2_PACKAGE_KMOD_TOOLS=y
BR2_PACKAGE_UTIL_LINUX_BINARIES=y
BR2_PACKAGE_UTIL_LINUX_FSCK=y
BR2_PACKAGE_UTIL_LINUX_HWCLOCK=y
BR2_PACKAGE_UTIL_LINUX_LOGIN=y
BR2_PACKAGE_UTIL_LINUX_MOUNT=y
BR2_PACKAGE_UTIL_LINUX_MOUNTPOINT=y
BR2_PACKAGE_UTIL_LINUX_RFKILL=y
BR2_PACKAGE_VISION_APP=y
BR2_PACKAGE_VISION_SERVICES=y
# BR2_TARGET_ROOTFS_TAR is not set
BR2_PACKAGE_HOST_ENVIRONMENT_SETUP=y
```

## buildroot/package/vision-app/vision-services/Config.in
```kconfig
config BR2_PACKAGE_VISION_SERVICES
	bool "Vision services"
	select BR2_PACKAGE_SYSLOG_NG
	select BR2_PACKAGE_RK_OEM
	default n
	help
		Vision services 

menu "Services"
	depends on BR2_PACKAGE_VISION_SERVICES

config BR2_PACKAGE_VISION_AUTOPILOT_SERVICE
	bool "Auto pilot service"
	depends on BR2_PACKAGE_VISION_SERVICES
	default y

config BR2_PACKAGE_VISION_CAMERA_SERVICE
	bool "Camera service"
	depends on BR2_PACKAGE_VISION_SERVICES
	select BR2_PACKAGE_CAMERA_ENGINE 
	select BR2_PACKAGE_RKMEDIA
	select BR2_PACKAGE_LIBPNG
	default y

config BR2_PACKAGE_VISION_DETECTION_SERVICE
	bool "Object detection service"
	depends on BR2_PACKAGE_VISION_SERVICES
	select BR2_PACKAGE_RKNPU 
	select BR2_PACKAGE_RKNPU_USE_RKNN_API
	select BR2_PACKAGE_RKMEDIA_RKRGA
	default y

config BR2_PACKAGE_VISION_TRACKER_SERVICE
	bool "Object tracker service"
	depends on BR2_PACKAGE_VISION_SERVICES
	default y

config BR2_PACKAGE_VISION_DISPALY_SERVICE
	bool "Dispaly service"
	depends on BR2_PACKAGE_VISION_SERVICES
	default y

config BR2_PACKAGE_VISION_MSP_SERVICE
	bool "MSP service"
	depends on BR2_PACKAGE_VISION_SERVICES
	default y

config BR2_PACKAGE_VISION_QR_SCAN_SERVICE
	bool "QR scanner service"
	depends on BR2_PACKAGE_VISION_SERVICES
	select BR2_PACKAGE_ZBAR
	default y

config BR2_PACKAGE_VISION_VIDEO_SERVICE
	bool "Video service"
	depends on BR2_PACKAGE_VISION_SERVICES
	default y

config BR2_PACKAGE_VISION_OSD_SERVICE
	bool "OSD-Config service"
	depends on BR2_PACKAGE_VISION_SERVICES
	default y

config BR2_PACKAGE_VISION_ENCRYPTED
	bool "Encrypt critical services"
	depends on BR2_PACKAGE_VISION_SERVICES
	default n

endmenu
```
